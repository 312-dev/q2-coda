## os/Config.in
```kconfig
menu "Vamp OS"
source "$BR2_EXTERNAL_VAMP_PATH/package/q2-mbedtls/Config.in"
source "$BR2_EXTERNAL_VAMP_PATH/package/q2player-ffmpeg/Config.in"
source "$BR2_EXTERNAL_VAMP_PATH/package/q2player/Config.in"
source "$BR2_EXTERNAL_VAMP_PATH/package/q2playd/Config.in"
source "$BR2_EXTERNAL_VAMP_PATH/package/q2sysd/Config.in"
source "$BR2_EXTERNAL_VAMP_PATH/package/q2libd/Config.in"
source "$BR2_EXTERNAL_VAMP_PATH/package/q2netd/Config.in"
source "$BR2_EXTERNAL_VAMP_PATH/package/q2pkgd/Config.in"
source "$BR2_EXTERNAL_VAMP_PATH/package/q2ui-stb/Config.in"
source "$BR2_EXTERNAL_VAMP_PATH/package/q2ui/Config.in"
source "$BR2_EXTERNAL_VAMP_PATH/package/vamp-assets/Config.in"
source "$BR2_EXTERNAL_VAMP_PATH/package/q2-adbd/Config.in"
source "$BR2_EXTERNAL_VAMP_PATH/package/q2adb/Config.in"
source "$BR2_EXTERNAL_VAMP_PATH/package/vamp-bluez/Config.in"
source "$BR2_EXTERNAL_VAMP_PATH/package/q2-freeaptx/Config.in"
source "$BR2_EXTERNAL_VAMP_PATH/package/q2-ldac/Config.in"
source "$BR2_EXTERNAL_VAMP_PATH/package/vamp-bluealsa/Config.in"
source "$BR2_EXTERNAL_VAMP_PATH/package/q2btd/Config.in"
endmenu
```

## os/package/q2-adbd/Config.in
```kconfig
config BR2_PACKAGE_Q2_ADBD
	bool "q2-adbd"
	help
	  Android 4.2.2's adbd as today's --dev builds have it (docs/adb.md#adbd): Debian's android-tools
	  source, its patches, libmincrypt and tools/adbd.patch, built by tools/thirdparty.py's build_adbd
	  against this image's glibc.
```

## os/package/q2-freeaptx/Config.in
```kconfig
config BR2_PACKAGE_Q2_FREEAPTX
	bool "q2-freeaptx"
	help
	  The aptX and aptX HD codec bluez-alsa links (libfreeaptx, static), built by tools/thirdparty.py's
	  own recipe (docs/bluealsa.md#codecs-and-licences).
```

## os/package/q2-guest/Config.in
```kconfig
config BR2_PACKAGE_Q2_GUEST
	bool "q2-guest"
	depends on BR2_PACKAGE_VAMP_BLUEALSA
	select BR2_PACKAGE_DBUS
	help
	  Guest Play (docs/platform/guest.md): today's q2-guest, serving Q2GUEST/1 on
	  /run/vamp/guest.sock to q2ui, and q2-hotspot, the hotspot script it runs.
```

## os/package/q2-iap/Config.in
```kconfig
config BR2_PACKAGE_Q2_IAP
	bool "q2-iap"
	select BR2_PACKAGE_SQLITE
	help
	  Car Audio (docs/iphone-mode.md, docs/car-audio-os.md): q2-iap, the iPhone a car sees over
	  USB, q2car, its gadget, and usb_f_uac1.ko, the USB Audio 1.0 function, from the tree
	  tools/vampos.py exported and the pinned module in the third-party cache.
```

## os/package/q2-iroh/Config.in
```kconfig
config BR2_PACKAGE_Q2_IROH
	bool "q2-iroh"
	help
	  Car Remote across networks (docs/carrd.md, docs/remote.md#car-remote-across-networks):
	  q2-iroh, the iroh sidecar q2carrd runs while Wi-Fi has a link. Rust, so not built
	  here: tools/iroh.py's pinned binary from the third-party cache, checked by its
	  SHA-256 (docs/vamp-os-base.md#toolchain-decisions).
```

## os/package/q2-ldac/Config.in
```kconfig
config BR2_PACKAGE_Q2_LDAC
	bool "q2-ldac"
	help
	  Sony's LDAC encoder and its adaptive bit rate library as Android publishes them, static, for
	  bluez-alsa (docs/bluealsa.md#codecs-and-licences), built by tools/thirdparty.py's own recipe.
```

## os/package/q2-mbedtls/Config.in
```kconfig
config BR2_PACKAGE_Q2_MBEDTLS
	bool "q2-mbedtls"
	help
	  mbedTLS at tools/thirdparty.py's release, configured with its MBEDTLS_UNSET (a TLS client and nothing
	  more), static, for q2player's FFmpeg (https). Staging only: nothing goes into the image.
```

## os/package/q2adb/Config.in
```kconfig
config BR2_PACKAGE_Q2ADB
	bool "q2adb"
	select BR2_PACKAGE_Q2_ADBD
	help
	  adb's helpers from patch/ (docs/adb.md): q2adb-gadget (the USB gadget), q2adb-wifi (adb over
	  Wi-Fi's supervisor: no port open without a trusted key) and q2adb-mdns (its _adb._tcp responder).
```

## os/package/q2btd/Config.in
```kconfig
config BR2_PACKAGE_Q2BTD
	bool "q2btd"
	depends on BR2_PACKAGE_VAMP_BLUEALSA
	select BR2_PACKAGE_DBUS
	help
	  VampOS's Bluetooth service (btd/, docs/btd.md): the client of vamp-bluez and vamp-bluealsa
	  over D-Bus, the pairing agent, auto-reconnect, the output q2playd plays to, and Q2BT/1 on
	  /run/vamp/bt.sock.
```

## os/package/q2carrd/Config.in
```kconfig
config BR2_PACKAGE_Q2CARRD
	bool "q2carrd"
	select BR2_PACKAGE_SQLITE
	help
	  Car Remote (docs/carrd.md): q2carrd, its side on VampOS (carrd/), and the coda-rc daemon
	  it runs (patch/coda_rc*.c, tools/build.py CODA_RC_SOURCES), built against this image's
	  libc and SQLite, from the tree tools/vampos.py exported.
```

## os/package/q2dacloop/Config.in
```kconfig
config BR2_PACKAGE_Q2DACLOOP
	bool "q2dacloop"
	select BR2_PACKAGE_ALSA_LIB
	help
	  USB DAC mode's audio (dacloop/, docs/dacloop.md): the USB gadget's capture, what a computer
	  plays, written to the Q2's DAC at the computer's rate.
```

## os/package/q2dlnad/Config.in
```kconfig
config BR2_PACKAGE_Q2DLNAD
	bool "q2dlnad"
	help
	  The DLNA renderer (dlnad/, docs/dlnad.md): a UPnP MediaRenderer whose URLs play
	  as Q2PLAY/1 sources, on while [SYSSET] DLNA=1.
```

## os/package/q2gate/Config.in
```kconfig
config BR2_PACKAGE_Q2GATE
	bool "q2gate"
	help
	  Vamp OS's side of q2ui's settings pipe and its status, Wi-Fi and
	  Bluetooth files, which demo's gate keeps on today's Vamp
	  (gate/, docs/gate.md).
```

## os/package/q2libd/Config.in
```kconfig
config BR2_PACKAGE_Q2LIBD
	bool "q2libd"
	select BR2_PACKAGE_SQLITE
	select BR2_PACKAGE_Q2PLAYER_FFMPEG
	select BR2_PACKAGE_Q2_MBEDTLS
	help
	  Vamp OS's library service (libd/, docs/libd.md), its first slice: the card's songs and the
	  signed-in apps' server catalogues, in the databases q2ui and q2playd read.
```

## os/package/q2netd/Config.in
```kconfig
config BR2_PACKAGE_Q2NETD
	bool "q2netd"
	select BR2_PACKAGE_WPA_SUPPLICANT
	help
	  VampOS's network service (netd/, docs/netd.md), its first slice: Wi-Fi on the saved networks,
	  DHCP, Smart Wi-Fi's idle off, and Q2NET/1 on /run/vamp/net.sock.
```

## os/package/q2pkgd/Config.in
```kconfig
config BR2_PACKAGE_Q2PKGD
	bool "q2pkgd"
	select BR2_PACKAGE_SQUASHFS
	select BR2_PACKAGE_SQUASHFS_LZO # mtd2's images are LZO; mksquashfs refuses to append to one without it
	select BR2_PACKAGE_Q2_MBEDTLS # download's HTTPS
	help
	  Vamp OS's update service (pkgd/, docs/pkgd.md): a release checked against the release key,
	  composed with this Q2's vendor set by the image's own mksquashfs, and staged for Shanling's
	  recovery, or downloaded from the release feed into the card's .vamp/os/ for the next card
	  boot. It never writes flash.
```

## os/package/q2playd/Config.in
```kconfig
config BR2_PACKAGE_Q2PLAYD
	bool "q2playd"
	select BR2_PACKAGE_SQLITE
	help
	  VampOS's playback service (playd/, docs/playd.md): the server end of q2player's socket, the
	  queue, what plays, and the command queue and now file q2ui uses, beside its own Q2PLAY/1 socket.
```

## os/package/q2player-ffmpeg/Config.in
```kconfig
config BR2_PACKAGE_Q2PLAYER_FFMPEG
	bool "q2player-ffmpeg"
	select BR2_PACKAGE_Q2_MBEDTLS
	help
	  FFmpeg at tools/player.py's release, configured with its configure_args() (the demuxers,
	  decoders and protocols q2player uses and nothing else), static. Staging only: q2player links it in.
```

## os/package/q2player/Config.in
```kconfig
config BR2_PACKAGE_Q2PLAYER
	bool "q2player"
	select BR2_PACKAGE_ALSA_LIB
	select BR2_PACKAGE_Q2PLAYER_FFMPEG
	select BR2_PACKAGE_Q2_MBEDTLS
	help
	  Vamp's player (player/, docs/player.md), built by player/Makefile as tools/player.py builds it for
	  every image (Car Audio's output on), against this image's alsa-lib.
```

## os/package/q2scrobd/Config.in
```kconfig
config BR2_PACKAGE_Q2SCROBD
	bool "q2scrobd"
	select BR2_PACKAGE_SQLITE
	select BR2_PACKAGE_Q2_MBEDTLS
	help
	  The scrobble log (scrobd/, docs/vamp-os-services.md#scrobbling): listens heard over
	  Q2PLAY/1 into the card's .scrobbler.log.
```

## os/package/q2sendd/Config.in
```kconfig
config BR2_PACKAGE_Q2SENDD
	bool "q2sendd"
	select BR2_PACKAGE_OPENSSL
	select BR2_PACKAGE_LIBOPENSSL
	help
	  LocalSend's receive side (sendd/, docs/vamp-os-services.md#localsend): today's q2send,
	  its questions asked through q2ui's Q2UI/1 notices.
```

## os/package/q2splash/Config.in
```kconfig
config BR2_PACKAGE_Q2SPLASH
	bool "q2splash"
	help
	  The boot animation (docs/boot.md#boot-animation): today's q2splash, patch/splash.c,
	  and assets/boot-anim.q2a, played by rcS on a boot from flash while q2ui waits.
```

## os/package/q2sysd/Config.in
```kconfig
config BR2_PACKAGE_Q2SYSD
	bool "q2sysd"
	help
	  Vamp OS's system service (sysd/, docs/sysd.md), its first slice: the power key, the screen's
	  light and the battery, and Q2SYS/1 on /run/vamp/sys.sock.
```
