## os/package/q2ui-stb/Config.in
```kconfig
config BR2_PACKAGE_Q2UI_STB
	bool "q2ui-stb"
	help
	  stb_truetype 1.26 and stb_image 2.30, the public-domain headers q2ui is compiled with, at
	  tools/ui.py's commit and hashes. Staging only, in usr/include/stb.
```

## os/package/q2ui/Config.in
```kconfig
config BR2_PACKAGE_Q2UI
	bool "q2ui"
	select BR2_PACKAGE_SQLITE
	select BR2_PACKAGE_Q2UI_STB
	select BR2_PACKAGE_VAMP_ASSETS
	help
	  Vamp's UI (ui/ on feat/render-engine, docs/ui-rewrite.md there), from the commit
	  tools/vampos.py pins (Q2UI_COMMIT) and exports into $(VAMP_SRC)/q2ui.
```

## os/package/vamp-assets/Config.in
```kconfig
config BR2_PACKAGE_VAMP_ASSETS
	bool "vamp-assets"
	help
	  The image's own fonts: Inter, under the SIL Open Font License, from assets/fonts/, at the
	  names q2ui opens (inter.ttf, inter-medium.ttf) in /usr/share/vamp/fonts.
```

## os/package/vamp-bluealsa/Config.in
```kconfig
config BR2_PACKAGE_VAMP_BLUEALSA
	bool "vamp-bluealsa"
	depends on BR2_PACKAGE_VAMP_BLUEZ
	select BR2_PACKAGE_ALSA_LIB
	select BR2_PACKAGE_SBC
	select BR2_PACKAGE_Q2_FREEAPTX
	select BR2_PACKAGE_Q2_LDAC
	help
	  Vamp's own bluealsa (docs/bluealsa.md): upstream bluez-alsa at tools/thirdparty.py's version and
	  patches, as bluealsa with bluealsa-aplay and the two ALSA plugins, against this image's glibc,
	  alsa-lib, D-Bus, GLib and vamp-bluez's libbluetooth.

config BR2_PACKAGE_VAMP_BLUEALSA_AAC
	bool "AAC (fdk-aac)"
	default y
	depends on BR2_PACKAGE_VAMP_BLUEALSA
	depends on BR2_INSTALL_LIBSTDCPP # fdk-aac
	select BR2_PACKAGE_FDK_AAC
	help
	  AAC through fdk-aac, which is C++: only with a toolchain that has C++
	  (BR2_TOOLCHAIN_BUILDROOT_CXX). Without it, the other four codecs.

comment "AAC needs a toolchain w/ C++"
	depends on BR2_PACKAGE_VAMP_BLUEALSA
	depends on !BR2_INSTALL_LIBSTDCPP
```

## os/package/vamp-bluez/Config.in
```kconfig
config BR2_PACKAGE_VAMP_BLUEZ
	bool "vamp-bluez"
	depends on BR2_USE_WCHAR # libglib2
	depends on BR2_TOOLCHAIN_HAS_THREADS # dbus, libglib2
	depends on BR2_USE_MMU # dbus, libglib2
	select BR2_PACKAGE_DBUS
	select BR2_PACKAGE_LIBGLIB2
	help
	  Vamp's own bluetoothd (docs/bluez.md): upstream BlueZ at tools/thirdparty.py's version, with
	  tools/bluez/vamp.patch (the [GATT] Server switch) and the store at /mnt/data/bluetooth, built
	  against this image's glibc, D-Bus and GLib; and libbluetooth, which bluez-alsa links.
```
